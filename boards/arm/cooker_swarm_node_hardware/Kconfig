## boards/arm/cooker_swarm_node_hardware/Kconfig
```kconfig
# Kconfig - cooker_swarm_node_hardware

if BOARD_COOKER_SWARM_NODE_HARDWARE

config BOARD_ENABLE_DCDC
        bool "Enable DCDC mode"
        select SOC_DCDC_NRF52X
        default y

endif # BOARD_COOKER_SWARM_NODE_HARDWARE
```

## boards/arm/cooker_swarm_node_hardware/Kconfig.board
```kconfig
# Kconfig - cooker_swarm_node_hardware board configuration

config  BOARD_COOKER_SWARM_NODE_HARDWARE
	bool "cooker_swarm_node_hardware"
	depends on SOC_NRF52840_QIAA
```
